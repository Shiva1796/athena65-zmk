## boards/arm/athena/Kconfig.defconfig
```kconfig
if BOARD_ATHENA

config ZMK_KEYBOARD_NAME
    default "Athena"

if USB_DEVICE_STACK

config USB_NRFX
    default y

endif # USB_DEVICE_STACK

config BT_CTLR
    default BT

config ZMK_BLE
    default y

config ZMK_USB
    default y

endif # BOARD_ATHENA
```

## boards/arm/athena/athena_defconfig
```kconfig
# Keyboard display name
CONFIG_ZMK_KEYBOARD_NAME="Athena"

# # Board configuration
CONFIG_SOC_SERIES_NRF52X=y
CONFIG_SOC_NRF52840_QIAA=y
CONFIG_BOARD_ATHENA=y

# Enable MPU
CONFIG_ARM_MPU=y

CONFIG_PINCTRL=y

# enable GPIO
CONFIG_GPIO=y



# Flash and memory settings
CONFIG_USE_DT_CODE_PARTITION=y
CONFIG_BUILD_OUTPUT_UF2=y
CONFIG_MPU_ALLOW_FLASH_WRITE=y
CONFIG_NVS=y
CONFIG_SETTINGS_NVS=y
CONFIG_FLASH=y
CONFIG_FLASH_PAGE_LAYOUT=y
CONFIG_FLASH_MAP=y

# Bluetooth settings
CONFIG_BT_MAX_PAIRED=5
CONFIG_BT_MAX_CONN=5

# Windows compatibility settings
CONFIG_BT_CTLR_PHY_2M=n
CONFIG_ZMK_BLE_EXPERIMENTAL_CONN=y

# Encoder Settings
CONFIG_EC11=y
CONFIG_EC11_TRIGGER_GLOBAL_THREAD=y

# Bluetooth connection optimization
CONFIG_BT_CTLR_TX_PWR_PLUS_8=y
CONFIG_BT_PERIPHERAL_PREF_MIN_INT=6
CONFIG_BT_PERIPHERAL_PREF_MAX_INT=12
CONFIG_BT_GAP_AUTO_UPDATE_CONN_PARAMS=y

# RGB underglow settings
CONFIG_ZMK_RGB_UNDERGLOW=y
CONFIG_WS2812_STRIP=y

CONFIG_ZMK_RGB_UNDERGLOW_HUE_START=160
CONFIG_ZMK_RGB_UNDERGLOW_EFF_START=2
CONFIG_ZMK_RGB_UNDERGLOW_BRT_MIN=10
CONFIG_ZMK_RGB_UNDERGLOW_BRT_MAX=15
CONFIG_ZMK_RGB_UNDERGLOW_AUTO_OFF_IDLE=y


# Power management settings
CONFIG_ZMK_IDLE_TIMEOUT=300000     
CONFIG_ZMK_SLEEP=y
CONFIG_ZMK_IDLE_SLEEP_TIMEOUT=900000  


# Key debounce settings
CONFIG_ZMK_KSCAN_DEBOUNCE_PRESS_MS=10
CONFIG_ZMK_KSCAN_DEBOUNCE_RELEASE_MS=10

# Enable USB and BLE
CONFIG_ZMK_USB=y
CONFIG_ZMK_BLE=y
CONFIG_USB_DEVICE_MANUFACTURER="NyxKeys"


# Battery Reporting
CONFIG_ZMK_BATTERY_REPORTING=y

# ZMK Studio support
CONFIG_ZMK_STUDIO=y

# # USB console logging for debugging
# CONFIG_ZMK_USB_LOGGING=y

# Enable deep sleep support
CONFIG_ZMK_SLEEP=y
```

## config/west.yml
```yaml
manifest:
  remotes:
    - name: zmkfirmware
      url-base: https://github.com/zmkfirmware
    - name: bluedrink9
      url-base: https://github.com/bluedrink9
  projects:
    - name: zmk
      remote: zmkfirmware
      revision: main
      import: app/west.yml
    - name: zmk-poor-mans-led-indicator
      remote: bluedrink9
      revision: main
  self:
    path: config
```
